## main/Kconfig.projbuild
```kconfig
menu "Motor Controller Configuration"
    config SINE_WAVE_SAMPLE_TIMEus
        int "Sine wave sample time (us)"
        range 100 2000
        default 1000
        help
            The sample time of the generated sine wave.
            This value influences the "graininess" of the output signal and the maximum frecuency that the controller can generate.
            A value of 100us corresponds to about a maximum frecuency of 1.25kHz, while a value of 500us yields a maximum frecuency of 250Hz
endmenu
```
